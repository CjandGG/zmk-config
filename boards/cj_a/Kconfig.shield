## boards/cj_a/Kconfig.shield
```kconfig
config SHIELD_CJ_A_LEFT
    def_bool $(shields_list_contains,cj_a_left)

config SHIELD_CJ_A_RIGHT
    def_bool $(shields_list_contains,cj_a_right)
```

## boards/shields/cj_a/Kconfig.defconfig
```kconfig
# SPDX-License-Identifier: MIT

if SHIELD_CJ_A_LEFT

config ZMK_KEYBOARD_NAME
    default "CJ A Left"

config ZMK_SPLIT_ROLE_CENTRAL
    default y

endif

if SHIELD_CJ_A_RIGHT

config ZMK_KEYBOARD_NAME
    default "CJ A Right"

endif

if SHIELD_CJ_A_LEFT || SHIELD_CJ_A_RIGHT

config ZMK_SPLIT
    default y

# 显示屏相关配置（如果你有 OLED）
if ZMK_DISPLAY

config I2C
    default y

config SSD1306
    default y

choice LV_COLOR_DEPTH
    default LV_COLOR_DEPTH_1
endchoice

config LV_Z_VDB_SIZE
    default 64

config LV_DPI_DEF
    default 148

config LV_Z_BITS_PER_PIXEL
    default 1

endif # ZMK_DISPLAY

# RGB 底灯（如果有）
if ZMK_RGB_UNDERGLOW

config WS2812_STRIP
    default y

endif

endif # SHIELD_CJ_A_LEFT || SHIELD_CJ_A_RIGHT
```

## boards/shields/cj_a/Kconfig.shield
```kconfig
config SHIELD_SOFLE_LEFT
    def_bool $(shields_list_contains,cj_a_left)

config SHIELD_SOFLE_RIGHT
    def_bool $(shields_list_contains,cj_a_right)
```
